## arch/arm/mach-sti/Kconfig
```kconfig
if ARCH_STI

config SPL
	select SPL_BOARD_INIT
	select SPL_CLK
	select SPL_DM
	select SPL_DM_SEQ_ALIAS
	select SPL_DRIVERS_MISC
	select SPL_FRAMEWORK
	select SPL_GPIO
	select SPL_LIBCOMMON_SUPPORT
	select SPL_LIBGENERIC_SUPPORT
	select SPL_OF_CONTROL
	select SPL_OF_TRANSLATE
	select SPL_PINCTRL
	select SPL_REGMAP
#	select SPL_DM_RESET
	select SPL_SERIAL
	select SPL_SYSCON
	select SPL_WATCHDOG if WATCHDOG
	imply BOOTSTAGE_STASH if SPL_BOOTSTAGE
	imply SPL_BOOTSTAGE if BOOTSTAGE
	imply SPL_DISPLAY_PRINT
	imply SPL_LIBDISK_SUPPORT
	imply SPL_SPI_LOAD if SPL_SPI

config SYS_SOC
	default "stih410"

choice
	prompt "STiH410 board select"

config TARGET_STIH410_B2260
	bool "96Boards STiH410-B2260"
	help
	  Support for 96Board STiH410-B2260 based on STMicroelectronics
	  STiH410 soc. This board complies with 96Board Open Platform
	  Specifications. Features:
	  - 1GB DDR
	  - On-Board USB combo WiFi/Bluetooth RTL8723BU
	    with PCB soldered antenna
	  - Ethernet 1000-BaseT
	  - Sata
	  - HDMI
	  - 2 x USB2 type A
	  - micro USB2 type AB
	  - SD card slot
	  - High speed connector (SD/I2C/USB interfaces)
	  - Low speed connector (UART/I2C/GPIO/SPI/PCM interfaces)

endchoice

source "board/st/stih410-b2260/Kconfig"

endif
```

## board/st/stih418-b2264/Kconfig
```kconfig
if TARGET_STIH418_B2264

config SYS_BOARD
	string
	default "stih418-b2264"

config SYS_VENDOR
	string
	default "st"

config SYS_SOC
	string
	default "stih418"

config SYS_CONFIG_NAME
	string
	default "stih418-b2264"

config TARGET_STIH418_B2264_LIBBTFMW_PATH
	string "Path to the libbtfmw.a file"
	help
	  U-boot SPL for STiH418-B2264 requires to be linked with the
	  libbtfmw.a library which provide early platform initialize
	  code.

endif
```

## configs/stih418-b2264_defconfig
```kconfig
CONFIG_ARM=y
CONFIG_SKIP_LOWLEVEL_INIT=y
# CONFIG_SPL_USE_ARCH_MEMCPY is not set
# CONFIG_SPL_USE_ARCH_MEMSET is not set
CONFIG_ARCH_STI=y
CONFIG_TEXT_BASE=0x60000000
CONFIG_SYS_MALLOC_LEN=0x18000000
CONFIG_SYS_MALLOC_F_LEN=0x400000
CONFIG_NR_DRAM_BANKS=1
CONFIG_SPL_LDSCRIPT="board/st/stih418-b2264/u-boot-spl.lds"
CONFIG_ENV_SIZE=0x4000
CONFIG_DEFAULT_DEVICE_TREE="stih418-b2264"
CONFIG_OF_LIBFDT_OVERLAY=y
CONFIG_MULTI_DTB_FIT_UNCOMPRESS_SZ=0x4000
CONFIG_SPL_MMC=y
CONFIG_SPL_SYS_MALLOC_F_LEN=0x100000
CONFIG_SPL_SIZE_LIMIT=0x1000000
CONFIG_TARGET_STIH418_B2264=y
CONFIG_IDENT_STRING="STMicroelectronics STiH418-B2264"
CONFIG_SPL_FS_FAT=y
# CONFIG_SPL_LIBDISK_SUPPORT is not set
CONFIG_SYS_LOAD_ADDR=0x80000000
CONFIG_ANDROID_BOOT_IMAGE=y
CONFIG_FIT=y
CONFIG_FIT_VERBOSE=y
CONFIG_SPL_FIT_PRINT=y
CONFIG_SPL_FIT_FULL_CHECK=y
CONFIG_SPL_LOAD_FIT=y
CONFIG_SPL_LOAD_FIT_ADDRESS=0x80000000
CONFIG_DISTRO_DEFAULTS=y
CONFIG_USE_BOOTARGS=y
CONFIG_BOOTARGS="console=ttyAS1,115200 CONSOLE=/dev/ttyAS1 consoleblank=0 root=/dev/mmcblk0p2 rootfstype=ext4 rw rootwait mem=992M@0x40000000 vmalloc=256m"
# CONFIG_DISPLAY_CPUINFO is not set
CONFIG_LAST_STAGE_INIT=y
CONFIG_STACKPROTECTOR=y
CONFIG_SPL_STACKPROTECTOR=y
CONFIG_SPL_HAS_BSS_LINKER_SECTION=y
CONFIG_SPL_BSS_START_ADDR=0x6010000
CONFIG_SPL_BSS_MAX_SIZE=0x2000
CONFIG_SPL_SHOW_ERRORS=y
CONFIG_SPL_SYS_MALLOC_SIMPLE=y
CONFIG_SPL_SEPARATE_BSS=y
CONFIG_SPL_SYS_MALLOC=y
CONFIG_SPL_SYS_MALLOC_SIZE=0x84000
# CONFIG_SPL_DISPLAY_PRINT is not set
CONFIG_SPL_FS_LOAD_PAYLOAD_NAME="u-boot.img"
CONFIG_SPL_DM_RESET=y
CONFIG_SPL_YMODEM_SUPPORT=y
CONFIG_SYS_PROMPT="stih418-b2264 => "
CONFIG_SYS_PBSIZE=1058
CONFIG_SYS_BOOTM_LEN=0x1000000
CONFIG_CMD_ASKENV=y
CONFIG_CMD_GPT=y
CONFIG_CMD_MMC=y
CONFIG_CMD_USB=y
CONFIG_CMD_TIME=y
CONFIG_CMD_TIMER=y
CONFIG_CMD_EXT4_WRITE=y
# CONFIG_ISO_PARTITION is not set
CONFIG_OF_CONTROL=y
CONFIG_OF_EMBED=y
CONFIG_SYS_RELOC_GD_ENV_ADDR=y
CONFIG_USE_BOOTFILE=y
CONFIG_BOOTFILE="uImage"
CONFIG_DM_STATS=y
CONFIG_REGMAP=y
CONFIG_SYSCON=y
CONFIG_CLK=y
CONFIG_MISC=y
CONFIG_MMC_SDHCI=y
CONFIG_MMC_SDHCI_STI=y
CONFIG_PHY=y
CONFIG_STI_USB_PHY=y
CONFIG_PINCTRL=y
CONFIG_STI_RESET=y
CONFIG_STI_ASC_SERIAL=y
CONFIG_SYSRESET=y
CONFIG_TIMER=y
CONFIG_SPL_TIMER=y
CONFIG_USB=y
CONFIG_USB_XHCI_HCD=y
CONFIG_USB_XHCI_DWC3=y
CONFIG_USB_EHCI_HCD=y
CONFIG_USB_EHCI_GENERIC=y
CONFIG_USB_OHCI_HCD=y
CONFIG_USB_OHCI_GENERIC=y
CONFIG_USB_DWC3=y
CONFIG_USB_HOST_ETHER=y
CONFIG_USB_ETHER_ASIX=y
CONFIG_USB_ETHER_MCS7830=y
CONFIG_USB_ETHER_SMSC95XX=y
CONFIG_USB_GADGET=y
CONFIG_USB_GADGET_MANUFACTURER="STMicroelectronics"
CONFIG_USB_GADGET_VENDOR_NUM=0x483
CONFIG_USB_GADGET_PRODUCT_NUM=0x7270
CONFIG_USB_GADGET_DOWNLOAD=y
CONFIG_FAT_WRITE=y
CONFIG_SPL_TINY_MEMSET=y
# CONFIG_EFI_LOADER is not set
```
